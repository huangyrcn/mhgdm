## configs/sample.yaml
```yaml
# configs/config.yaml
defaults:
  - data : ENZYMES
  - fsl_task : 10shot
  - train : sample
  - _self_


# 实验配置
exp_name: "sample"
timestamp: ${now:%Y%m%d_%H%M%S}
run_name: ${exp_name}_${timestamp}  # 自动组合exp_name和时间戳
debug: false

data:
  batch_size: 512

sample:
  eps: 0.0001
  noise_removal: true
  probability_flow: false
  seed: 1
  use_ema: true

sampler:
  corrector: Langevin
  n_steps: 1
  predictor: Euler
  scale_eps_A: 1.0
  scale_eps_x: 1.0
  snr_A: 0.25
  snr_x: 0.25
  proto_guide: true
  
ae_ckpt_path: checkpoints/ENZYMES/ae_model_train/20250430_103446/best.pth
score_ckpt_path: checkpoints/ENZYMES/score_model_train/20250430_111444/best.pth



seed: 4
device: auto
device_count: 1

hydra:
  run:
    dir: .
  output_subdir: null
  job_logging:
    disable_existing_loggers: False
    formatters: null
    handlers: null
    root: null
    version: 1
  verbose: false

wandb:
  no_wandb: false
  online: true # Set to false for offline logging
  project: MHGDM
  wandb_usr: huangyr
  entity: huangyr_team



sde:
  adj:
    beta_max: 1.0
    beta_min: 0.2
    num_scales: 1000
    type: VE
  x:
    beta_max: 1.0
    beta_min: 0.1
    num_scales: 1000
    type: VP

train:
  ema: 0.999
  eps: 1.0e-05
  grad_norm: 1.0
  kl_regularization: 1.0e-05
  edge_weight: 1.0e-02
  proto_weight: 1.0e-02
  lr: 0.01
  lr_decay: 0.999
  lr_schedule: true
  num_epochs: 1000
  print_interval: 50
  reduce_mean: true
  save_interval: 50
  weight_decay: 0.0001
  
```
